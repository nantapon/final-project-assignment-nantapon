## base_external/Config.in
```kconfig
source "$BR2_EXTERNAL_netsim_PATH/package/netsim_app/Config.in"
source "$BR2_EXTERNAL_netsim_PATH/package/netsim_ui/Config.in"
```

## base_external/package/netsim_app/Config.in
```kconfig
config BR2_PACKAGE_NETSIM_APP
	bool "netsim_app"
	help
	  Network Simulator App 
```

## base_external/package/netsim_helper/Config.in
```kconfig
config BR2_PACKAGE_NETSIM_HELPER
	bool "netsim_helper"
	help
	  Network Simulator helper 
```
